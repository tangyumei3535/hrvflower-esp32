## boards/espressif/esp_SensairShuttle/sdkconfig.defaults.board
```kconfig
CONFIG_ESPTOOLPY_FLASHMODE_QIO=y
CONFIG_ESPTOOLPY_FLASHFREQ_80M=y
CONFIG_ESPTOOLPY_FLASHSIZE_8MB=y
CONFIG_SPIRAM=y
CONFIG_SPIRAM_MODE_QUAD=y
CONFIG_SPIRAM_SPEED_80M=y
# Primary console: UART0 (115200). Secondary: USB Serial/JTAG for run-mode flash.
CONFIG_ESP_CONSOLE_UART_DEFAULT=y
# CONFIG_ESP_CONSOLE_USB_SERIAL_JTAG is not set
# CONFIG_ESP_CONSOLE_SECONDARY_NONE is not set
CONFIG_ESP_CONSOLE_SECONDARY_USB_SERIAL_JTAG=y
```

## boards/m5stack/m5_AtomS3R/sdkconfig.defaults.board
```kconfig
CONFIG_ESPTOOLPY_FLASHMODE_QIO=y
CONFIG_ESPTOOLPY_FLASHFREQ_80M=y
CONFIG_ESPTOOLPY_FLASHSIZE_8MB=y
CONFIG_SPIRAM=y
CONFIG_SPIRAM_MODE_OCT=y
CONFIG_SPIRAM_SPEED_80M=y
CONFIG_SPIRAM_MEMTEST=n
CONFIG_SPIRAM_MALLOC_ALWAYSINTERNAL=2048
CONFIG_SPIRAM_MALLOC_RESERVE_INTERNAL=98304
CONFIG_ESP_CONSOLE_USB_SERIAL_JTAG=y
CONFIG_ESP_CONSOLE_SECONDARY_NONE=y
CONFIG_ESP_CONSOLE_UART_NUM=-1

# HRV low power + BMI270 any-motion wake (AtomS3R)
CONFIG_HRV_LOW_POWER_ENABLE=y
CONFIG_HRV_ACTIVE_WINDOW_SEC=90
CONFIG_HRV_IMU_WAKE_ENABLE=y
CONFIG_HRV_IMU_INT_GPIO=16
CONFIG_HRV_IMU_I2C_SDA_GPIO=45
CONFIG_HRV_IMU_I2C_SCL_GPIO=0

# USER button (GPIO41) + Atomic Battery Base BAT ADC (AtomS3R = GPIO8 per M5 docs)
CONFIG_HRV_USER_BTN_ENABLE=y
CONFIG_HRV_BATTERY_ADC_ENABLE=y
CONFIG_HRV_BATTERY_ADC_GPIO=8
```

## main/Kconfig.projbuild
```kconfig
menu "HRV Emotion Flower"

    config HRV_WIFI_SSID
        string "Default Wi-Fi SSID (optional seed)"
        default ""
        help
            If NVS has no saved networks, this SSID/password pair is written once
            on first boot. Leave empty to force captive-portal setup instead.

    config HRV_WIFI_PASSWORD
        string "Default Wi-Fi password"
        default ""
        help
            Password paired with HRV_WIFI_SSID for the one-time NVS seed.

    config BEMFA_PRIVATE_KEY
        string "Bemfa private key (UID)"
        default ""
        help
            Your Bemfa cloud private key (UID). Used in HTTP POST uid field.
            In single-device mode, also used as MQTT client_id.

    choice BEMFA_MQTT_AUTH_MODE
        prompt "Bemfa MQTT authentication mode"
        default BEMFA_MQTT_AUTH_UID
        help
            Bemfa mode 1: client_id must equal UID (one board per UID).
            Bemfa mode 2: unique client_id + AppID/secretKey (multi-device).

        config BEMFA_MQTT_AUTH_UID
            bool "UID as client_id (single device)"
            help
                Standard Bemfa auth. Only one board can hold an MQTT session
                per UID; a second board with the same UID will kick the first.

        config BEMFA_MQTT_AUTH_APPKEY
            bool "AppID + secretKey (multi-device)"
            help
                Unique client_id per board (Wi-Fi MAC) with username=AppID and
                password=secretKey. Multiple boards can subscribe to the same topic.
                Generate credentials via Bemfa API (see help for App ID field).

    endchoice

    config BEMFA_MQTT_APP_ID
        string "Bemfa MQTT App ID"
        depends on BEMFA_MQTT_AUTH_APPKEY
        default ""
        help
            AppID for Bemfa auth mode 2. Generate with:
            curl -X POST https://pro.bemfa.com/vs/web/v1/userSecretKey \\
              -H "Content-Type: application/json" \\
              -d '{"openID":"<your UID>"}'

    config BEMFA_MQTT_SECRET_KEY
        string "Bemfa MQTT secret key"
        depends on BEMFA_MQTT_AUTH_APPKEY
        default ""
        help
            secretKey paired with BEMFA_MQTT_APP_ID (same API call as App ID).

    config BEMFA_MQTT_TOPIC
        string "Bemfa MQTT topic name"
        default "hrv001"
        help
            Topic created in Bemfa console. iOS Shortcut should POST to this topic.

    config BEMFA_MQTT_BROKER_URI
        string "MQTT broker URI"
        default "mqtt://bemfa.com:9501"
        help
            Bemfa MQTT broker. Plain TCP port 9501 per official documentation.

    menu "Low power (deep sleep)"

        config HRV_LOW_POWER_ENABLE
            bool "Enable deep sleep after active window"
            default n
            help
                After the last valid MQTT payload, stay awake HRV_ACTIVE_WINDOW_SEC,
                then turn off backlight and enter deep sleep. No RTC timer wake.
                NVS-cached UI is shown after wake. AtomS3R: optional BMI270 EXT1 wake.

        config HRV_ACTIVE_WINDOW_SEC
            int "Idle time after last MQTT before deep sleep (seconds)"
            depends on HRV_LOW_POWER_ENABLE
            default 90
            range 10 600
            help
                Each valid MQTT payload or USER button press resets this idle
                timer. Deep sleep starts when neither occurs for this many seconds.

        config HRV_IMU_WAKE_ENABLE
            bool "BMI270 any-motion wake from deep sleep (AtomS3R)"
            depends on HRV_LOW_POWER_ENABLE
            default y
            help
                Configure on-board BMI270 (Toy firmware) for any-motion on INT1.
                Wake via ESP32-S3 EXT1 on RTC GPIO (default 16). Side reset (EN) always wakes.

        config HRV_IMU_INT_GPIO
            int "BMI270 INT1 GPIO (RTC 0-21; NOT GPIO3=32K crystal)"
            depends on HRV_IMU_WAKE_ENABLE
            default 16
            range 0 21

        config HRV_IMU_I2C_SDA_GPIO
            int "BMI270 I2C SDA GPIO"
            depends on HRV_IMU_WAKE_ENABLE
            default 45
            range 0 48

        config HRV_IMU_I2C_SCL_GPIO
            int "BMI270 I2C SCL GPIO"
            depends on HRV_IMU_WAKE_ENABLE
            default 0
            range 0 48

    endmenu

    menu "OTA (HTTPS)"

        config HRV_OTA_ENABLE
            bool "Enable HTTPS OTA (dual ota_0/ota_1 partitions)"
            default y
            help
                Requires custom partitions.csv with ota_0 and ota_1.
                First flash after partition change: flash partition table + app
                (idf.py erase-flash or full flash). Upgrade via MQTT JSON or
                menuconfig default URL.

        config HRV_OTA_USE_CERT_BUNDLE
            bool "Use ESP x509 certificate bundle for HTTPS OTA"
            depends on HRV_OTA_ENABLE
            default y
            help
                Verify HTTPS server with built-in root CA bundle. Disable only
                for lab servers with a custom cert_pem (not implemented here).

        config HRV_OTA_SKIP_COMMON_NAME_CHECK
            bool "Skip TLS common-name check (lab only)"
            depends on HRV_OTA_ENABLE
            default n

        config HRV_OTA_URL_MAX_LEN
            int "Max OTA URL length (MQTT + menuconfig)"
            depends on HRV_OTA_ENABLE
            default 256
            range 64 512

        config HRV_OTA_DEFAULT_URL
            string "Optional HTTPS firmware URL (boot-time upgrade)"
            depends on HRV_OTA_ENABLE
            default ""
            help
                If non-empty, run OTA once after Wi-Fi is up (before MQTT idle
                window / deep sleep). Leave empty to upgrade only via MQTT
                {"type":"ota","url":"https://..."}.

    endmenu

    menu "System info (USER button + battery ADC)"

        config HRV_USER_BTN_ENABLE
            bool "USER button toggles version + battery page"
            default y
            help
                Screen-back button (AtomS3R GPIO41, active low). Each press toggles
                between the HRV flower UI and a system info overlay. Battery ADC is
                sampled only when entering the system page (no background polling).

        config HRV_USER_BTN_GPIO
            int "USER button GPIO"
            depends on HRV_USER_BTN_ENABLE
            default 41
            range 0 48

        config HRV_BATTERY_ADC_ENABLE
            bool "Battery voltage via ADC on system page"
            depends on HRV_USER_BTN_ENABLE
            default y

        config HRV_BATTERY_ADC_GPIO
            int "Battery ADC GPIO (M5 Atomic Battery Base)"
            depends on HRV_BATTERY_ADC_ENABLE
            default 8
            range 0 48
            help
                M5 Atomic Battery Base BAT ADC per product line:
                AtomS3 / AtomS3-Lite / AtomS3R / AtomS3R-CAM / AtomS3R-M12: GPIO8.
                Atom-Lite / Atom-Matrix: GPIO33.
                See https://docs.m5stack.com/en/atom/Atomic%20Battery%20Base

    endmenu

endmenu
```

## sdkconfig.defaults
```kconfig
# HRV Emotion Flower — project defaults (Flash/PSRAM/console per board sdkconfig.defaults.board)
CONFIG_PARTITION_TABLE_CUSTOM=y
CONFIG_PARTITION_TABLE_CUSTOM_FILENAME="partitions.csv"
CONFIG_MBEDTLS_CERTIFICATE_BUNDLE=y
CONFIG_MBEDTLS_CERTIFICATE_BUNDLE_DEFAULT_FULL=y
CONFIG_ESP_HTTPS_OTA_ENABLE_PARTIAL_DOWNLOAD=y
CONFIG_MBEDTLS_SSL_IN_CONTENT_LEN=16384
CONFIG_COMPILER_OPTIMIZATION_PERF=y
CONFIG_SPIRAM_TRY_ALLOCATE_WIFI_LWIP=y
CONFIG_ESP_MAIN_TASK_STACK_SIZE=8192
CONFIG_ESP_SYSTEM_EVENT_TASK_STACK_SIZE=4096
CONFIG_FREERTOS_HZ=1000
CONFIG_LV_USE_CLIB_MALLOC=y
CONFIG_LV_USE_CLIB_STRING=y
CONFIG_LV_USE_CLIB_SPRINTF=y
CONFIG_LV_FONT_MONTSERRAT_10=y
CONFIG_LV_FONT_MONTSERRAT_12=y
CONFIG_LV_FONT_MONTSERRAT_14=y
CONFIG_LV_BUILD_EXAMPLES=n
CONFIG_IDF_EXPERIMENTAL_FEATURES=y
```
